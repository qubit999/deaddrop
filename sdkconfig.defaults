## sdkconfig.defaults
```kconfig
# Partition Table
CONFIG_PARTITION_TABLE_CUSTOM=y
CONFIG_PARTITION_TABLE_CUSTOM_FILENAME="partitions.csv"
CONFIG_PARTITION_TABLE_FILENAME="partitions.csv"

# WiFi
CONFIG_ESP_WIFI_ENABLED=y
CONFIG_ESP_WIFI_SOFTAP_SUPPORT=y

# HTTP Server
CONFIG_HTTPD_MAX_REQ_HDR_LEN=1024
CONFIG_HTTPD_MAX_URI_LEN=512

# SPIFFS
CONFIG_SPIFFS_MAX_PARTITIONS=3

# mbedTLS
CONFIG_MBEDTLS_AES_C=y
CONFIG_MBEDTLS_SHA256_C=y

# FreeRTOS
CONFIG_FREERTOS_HZ=100

# Logging
CONFIG_LOG_DEFAULT_LEVEL_INFO=y

# Flash size
CONFIG_ESPTOOLPY_FLASHSIZE_16MB=y
CONFIG_ESPTOOLPY_FLASHSIZE="16MB"
```
